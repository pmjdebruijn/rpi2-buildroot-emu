## package/catsfc_plus/Config.in
```kconfig
config BR2_PACKAGE_CATSFC_PLUS
	bool "CATSFC_PLUS"
	depends on BR2_PACKAGE_RETROARCH
	depends on BR2_INSTALL_LIBSTDCPP
	help
	  A libretro SNES emulator core for ARM.

	  http://www.libretro.com

comment "CATSFC_PLUS needs a toolchain w/ C++"
	depends on !BR2_INSTALL_LIBSTDCPP
```

## package/fceumm/Config.in
```kconfig
config BR2_PACKAGE_FCEUMM
	bool "FCEUMM"
	depends on BR2_PACKAGE_RETROARCH
	depends on BR2_INSTALL_LIBSTDCPP
	help
	  A libretro NES emulator core for ARM.

	  http://www.libretro.com

comment "FCEUMM needs a toolchain w/ C++"
	depends on !BR2_INSTALL_LIBSTDCPP
```

## package/nestopia/Config.in
```kconfig
config BR2_PACKAGE_NESTOPIA
	bool "NESTOPIA"
	depends on BR2_PACKAGE_RETROARCH
	depends on BR2_INSTALL_LIBSTDCPP
	help
	  A libretro NES emulator core for ARM.

	  http://www.libretro.com

comment "NESTOPIA needs a toolchain w/ C++"
	depends on !BR2_INSTALL_LIBSTDCPP
```
